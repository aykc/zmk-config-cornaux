#include <behaviors.dtsi>
#include <dt-bindings/zmk/keys.h>
#include <dt-bindings/zmk/bt.h>
#include <dt-bindings/zmk/pointing.h>

#define HOST_OS 1

#include "zmk-helpers/helper.h"
#include "key-labels.h"
#include "zmk-helpers/unicode-chars/russian.dtsi"

#include "combos.dtsi"

#define ___ &trans
#define XXX &none

#define EN 0
#define RU 1
#define GAME 2
#define GAME2 3
#define COLE 4
#define NAV 5
#define FUN 6
#define SYM 7
#define MOUSE 8
#define APPS 9
#define ADJ 10

/* Left-hand HRMs. */
ZMK_HOLD_TAP(hml,
  flavor = "balanced";
  tapping-term-ms = <280>;
  quick-tap-ms = <175>;
  require-prior-idle-ms = <150>;
  bindings = <&kp>, <&kp>;
  hold-trigger-key-positions = <KEYS_R THUMBS>;
  hold-trigger-on-release;
)

/* Right-hand HRMs. */
ZMK_HOLD_TAP(hmr,
  flavor = "balanced";
  tapping-term-ms = <280>;
  quick-tap-ms = <175>;
  require-prior-idle-ms = <150>;
  bindings = <&kp>, <&kp>;
  hold-trigger-key-positions = <KEYS_L THUMBS>;
  hold-trigger-on-release;
)

/* tap_dance for russian ru_soft/hard key */
ZMK_TAP_DANCE(td_ru_soft_hard, bindings = <&ru_soft>, <&ru_hard>;
              tapping-term-ms = <200>;)

/* tap_dance for russian ru_ye/yo key */
ZMK_TAP_DANCE(td_ru_ye_yo, bindings = <&ru_ye>, <&ru_yo>;
              tapping-term-ms = <200>;)

// Define mod-morph with a *single* mod trigger for less repetition.
#define SIMPLE_MORPH(NAME, MOD, BINDING1, BINDING2)                            \
  ZMK_MOD_MORPH(NAME, mods = <(MOD_L##MOD | MOD_R##MOD)>;                      \
                bindings = <BINDING1>, <BINDING2>;)

// Tap: dot | Shift + tap: comma
SIMPLE_MORPH(dot_morph, SFT, &kp DOT, &kp COMMA)

/ {
  conditional_layers {
    compatible = "zmk,conditional-layers";
    adjust_layer {
      if-layers = <NAV SYM>;
      then-layer = <ADJ>;
    };
  };

  keymap {
    compatible = "zmk,keymap";

    en_layer {
      display-name = "base en";
      bindings = <
    //╭───────────────┬───────────────┬───────────────┬───────────────┬───────────────┬───────────────╮ ╭───────────────┬───────────────┬───────────────┬───────────────┬───────────────┬───────────────╮
        &kp ESCAPE      &kp Q           &kp W           &kp E           &kp R           &kp T             &kp Y           &kp U           &kp I           &kp O           &kp P           &kp BSPC
    //├───────────────┼───────────────┼───────────────┼───────────────┼───────────────┼───────────────┤ ├───────────────┼───────────────┼───────────────┼───────────────┼───────────────┼───────────────┤
        &kp TAB         &hml LGUI A     &hml LALT S     &hml LCTRL D    &hml LSHIFT F   &kp G             &kp H           &hmr RSHIFT J   &hmr RCTRL K    &hmr RALT L     &hmr RGUI SEMI  &kp SQT
    //├───────────────┼───────────────┼───────────────┼───────────────┼───────────────┼───────────────┤ ├───────────────┼───────────────┼───────────────┼───────────────┼───────────────┼───────────────┤
        &kp CAPS        &kp Z           &kp X           &kp C           &kp V           &kp B             &kp N           &kp M           &kp COMMA       &kp DOT         &kp FSLH        &kp BSLH
    //╰───────────────┼───────────────┼───────────────┼───────────────┼───────────────┼───────────────┤ ├───────────────┼───────────────┼───────────────┼───────────────┼───────────────┼───────────────╯
                                        XXX             &kp LSHIFT      &lt SYM SPACE   &kp LALT          &mo FUN         &lt NAV RET     &kp RSHIFT      &kp DEL
      //                              ╰───────────────┴───────────────┴───────────────┴───────────────╯ ╰───────────────┴───────────────┴───────────────┴───────────────╯
      >;
    };

    ru_layer {
      display-name = "base ru";
      bindings = <
        &kp ESCAPE  &ru_y            &ru_ts             &ru_u              &ru_k               &td_ru_ye_yo        &ru_n         &ru_g                &ru_sh             &ru_shch          &ru_z            &kp BSPC
        &kp TAB     &hml LGUI &ru_f  &hml LALT &ru_bi   &hml LCTRL &ru_v   &hml LSHIFT &ru_a   &ru_p               &ru_r         &hmr RSHIFT &ru_o    &hmr RCTRL &ru_l   &hmr RALT &ru_d   &hmr RGUI &ru_zh &ru_e
        &kp CAPS    &ru_ya           &ru_ch             &ru_s              &ru_m               &ru_i               &ru_t         &td_ru_soft_hard     &ru_b              &ru_yu            &ru_kh           &dot_morph
                                     &to EN             &kp LSHIFT         &lt SYM SPACE       &kp LALT            &kp RALT      &lt NAV RETURN       &kp RSHIFT         &kp DEL
      >;
    };

    game_layer {
      display-name = "game";
      bindings = <
        &kp ESCAPE  &kp Q       &kp W        &kp E         &kp R          &kp T           &kp Y     &kp U           &kp I         &kp O        &kp P          &kp BSPC
        &kp TAB     &mt LGUI A  &mt LCTRL S  &mt LSHIFT D  &mt LALT F     &kp G           &kp H     &mt RALT J      &mt RSHIFT K  &mt RCTRL L  &mt RGUI SEMI  &kp SQT
        &kp CAPS    &kp Z       &kp X        &kp C         &kp V          &kp B           &kp N     &kp M           &kp COMMA     &kp DOT      &kp FSLH       &kp BSLH
                                &mo GAME2    &kp LSHIFT    &lt SYM SPACE  &kp LALT        &kp RALT  &lt NAV RETURN  &kp RSHIFT    &none
      >;
    };

    game2_layer {
      display-name = "game 2";
      bindings = <
        &kp ESCAPE  &kp Q       &kp W        &kp E         &kp R          &kp T           &kp Y     &kp U           &kp I         &kp O        &kp P          &kp BSPC
        &kp TAB     &mt LGUI A  &mt LCTRL S  &mt LSHIFT D  &mt LALT F     &kp G           &kp H     &mt RALT J      &mt RSHIFT K  &mt RCTRL L  &mt RGUI SEMI  &kp SQT
        &kp CAPS    &kp Z       &kp X        &kp C         &kp V          &kp B           &kp N     &kp M           &kp COMMA     &kp DOT      &kp FSLH       &kp BSLH
                                &trans       &kp LSHIFT    &lt SYM SPACE  &kp LALT        &kp RALT  &lt NAV RETURN  &kp RSHIFT    &none
      >;
    };

    colemak_layer {
      display-name = "colemak";
      bindings = <
        &kp ESCAPE  &kp Q       &kp W        &kp F         &kp P          &kp B           &kp J     &kp L           &kp U         &kp Y        &kp SEMI       &kp BSPC
        &kp TAB     &mt LGUI A  &mt LCTRL R  &mt LSHIFT S  &mt LALT T     &kp G           &kp M     &mt RALT N      &mt RSHIFT E  &mt RCTRL I  &mt RGUI O     &kp SQT
        &kp CAPS    &kp Z       &kp X        &kp C         &kp D          &kp V           &kp K     &kp H           &kp COMMA     &kp DOT      &kp FSLH       &kp BSLH
                                &to EN       &kp LSHIFT    &lt SYM SPACE  &kp LALT        &kp RALT  &lt NAV RETURN  &kp RSHIFT    &kp DEL
      >;
    };

    nav_layer {
      display-name = "nav";
      bindings = <
        XXX         XXX         XXX          XXX             XXX            XXX             XXX       &kp PG_UP       &kp UP        XXX         XXX            XXX
        XXX         XXX         XXX          XXX             XXX            XXX             &kp HOME  &kp LEFT        &kp DOWN      &kp RIGHT   &kp END        XXX
        XXX         XXX         XXX          XXX             XXX            XXX             XXX       &kp PG_DN       XXX           XXX         XXX            XXX
                                XXX          &kp LSHIFT      &lt SYM SPACE  &kp LALT        &mo FUN   &lt NAV RETURN  &kp RSHIFT    XXX
      >;
    };

    fun_layer {
      display-name = "fn media";
      bindings = <
        &kp  F1     &kp F2      &kp F3       &kp F4          &kp F5         &kp F6          &kp F7    &kp F8          &kp F9        &kp F10     &kp F11        &kp F12
        XXX         XXX         XXX          &kp C_BKLT_TOG  &kp C_BRI_UP   XXX             &kp C_RW  &kp C_PREV      &kp C_PP      &kp C_NEXT  &kp C_FF       &kp C_VOL_UP
        &kp PSCRN   XXX         XXX          XXX             &kp C_BRI_DN   XXX             XXX       XXX             &kp C_MUTE    XXX         XXX            &kp C_VOL_DN
                                XXX          &kp LSHIFT      &lt SYM SPACE  ___             ___       &lt NAV RETURN  &kp RSHIFT    XXX
      >;
    };

    num_sym_layer {
      display-name = "sym num";
      bindings = <
        &kp GRAVE  &kp N1       &kp N2       &kp N3        &kp N4         &kp N5          &kp N6    &kp N7          &kp N8        &kp N9     &kp N0     &kp BSPC
        XXX        XXX          XXX          &kp TILDE     &kp LBRC       &kp LPAR        &kp RPAR  &kp RBRC        &kp PLUS      &kp UNDER  &kp SEMI   &kp SQT
        XXX        XXX          XXX          &kp GRAVE     &kp LBKT       &kp LT          &kp GT    &kp RBKT        &kp EQUAL     &kp MINUS  &kp FSLH   &kp BSLH
                                &to EN       &kp LSHIFT    &lt SYM SPACE  &kp LALT        &kp RALT  &lt NAV RETURN  &kp RSHIFT    &kp DEL
      >;
    };

    mouse_layer {
      display-name = "mouse";
      bindings = <
        &none      &none      &none      &none        &none          &none           &msc SCRL_UP    &mkp MB4        &mmv MOVE_UP    &mkp MB5          &none             &none
        &none      &none      &none      &none        &none          &none           &msc SCRL_LEFT  &mmv MOVE_LEFT  &mmv MOVE_DOWN  &mmv MOVE_RIGHT   &msc SCRL_RIGHT   &none
        &none      &none      &none      &none        &none          &none           &msc SCRL_DOWN  &mkp LCLK       &mkp MCLK       &mkp RCLK         &none             &none
                              &to EN     &kp LSHIFT   &lt SYM SPACE  &kp LALT        &kp RALT        &lt NAV RETURN  &kp RSHIFT      &none
      >;
    };

    applications_layer {
      display-name = "apps";
      bindings = <
        &none      &none     &none       &none       &none          &none            &none      &none            &none         &none      &none      &none
        &none      &none     &none       &none       &none          &none            &none      &none            &none         &none      &none      &none
        &none      &none     &none       &none       &none          &none            &none      &none            &none         &none      &none      &none
                             &to EN      &kp LSHIFT  &lt SYM SPACE  &kp LALT         &kp RALT   &lt NAV RETURN   &kp RSHIFT    &none
      >;
    };

    adjust_layer {
      display-name = "adj";
      bindings = <
        &bt BT_CLR     &bt BT_SEL 0  &bt BT_SEL 1 &bt BT_SEL 2  &bt BT_SEL 3   &bt BT_SEL 4      &to EN    &to RU          &to COLE      &to GAME   &trans   &trans
        &studio_unlock &trans        &trans       &trans        &trans         &trans            &trans    &trans          &to MOUSE     &to APPS   &trans   &trans
        &trans         &trans        &trans       &trans        &trans         &trans            &trans    &trans          &trans        &trans     &trans   &trans
                                     &to EN       &kp LSHIFT    &lt SYM SPACE  &kp LALT          &kp RALT  &lt NAV RETURN  &kp RSHIFT    &none
      >;
    };
  };
};
