## boards/shields/cornaux/Kconfig.defconfig
```kconfig
if SHIELD_CORNAUX_LEFT

# Name must be less than 16 characters long!
config ZMK_KEYBOARD_NAME
    default "cornaux"

config ZMK_SPLIT_ROLE_CENTRAL
    default y

endif

if SHIELD_CORNAUX_LEFT || SHIELD_CORNAUX_RIGHT

config ZMK_SPLIT
    default y

if ZMK_DISPLAY

config I2C
    default y

config SSD1306
    default y

endif # ZMK_DISPLAY

endif
```

## boards/shields/cornaux/Kconfig.shield
```kconfig
# No whitespace after the comma or in your part name!
config SHIELD_CORNAUX_LEFT
    def_bool $(shields_list_contains,cornaux_left)

# No whitespace after the comma or in your part name!
config SHIELD_CORNAUX_RIGHT
    def_bool $(shields_list_contains,cornaux_right)
```
